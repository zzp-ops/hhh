/* ===========================================================================
 * OLED.c —— SSD1306 128x64 软件 I2C 驱动
 *
 * 移植自 oled 工程（HSI 8MHz / PB8-PB9），移植到 hh 工程后的三处改动：
 *
 *   ① 延时时基 —— 原工程按 8MHz 写死 4 次空循环；本工程 72MHz，
 *      空循环缩短 9 倍会把 SCL 推到 2MHz 以上（SSD1306 上限 400kHz）。
 *      现改为按 SystemCoreClock 自动换算，8MHz / 72MHz 都能落在 ~330kHz。
 *
 *   ② 引脚模式 —— hh 的 MX_GPIO_Init() 把 PB8/PB9 配成了推挽输出
 *      （GPIO_MODE_OUTPUT_PP）。I2C 必须开漏，否则模块的 5V 上拉会和
 *      MCU 的推挽高电平对顶。OLED_Init() 里重新配成 OUTPUT_OD 覆盖。
 *
 *   ③ 批量写 —— 原工程每个数据字节都单独发一次 起始+地址+控制+数据+停止，
 *      全屏 1024 字节要发 1024 帧。这里加了 OLED_WriteDataBlock()，
 *      控制字节 0x40 只发一次，后面连续发数据，全屏刷新快 3 倍多。
 *      对「OLED 刷新不能拖慢 5ms 控制周期」这条要求很关键。
 * =========================================================================== */

#include "OLED.h"

/* ===========================================================================
 * 8x16 点阵 ASCII 字库（' ' ~ '~'，共 95 个字符）
 *
 * 每字符 16 字节：前 8 字节是上半部分（占 1 页 8 列），后 8 字节是下半部分，
 * 与 OLED_ShowChar() 的取模方式一致。数据与参考工程完全一致。
 * =========================================================================== */
static const uint8_t OLED_F8x16[][16] =
{
    {0x00,0x00,0x00,0x00,0x00,0x00,0x00,0x00,0x00,0x00,0x00,0x00,0x00,0x00,0x00,0x00}, /*   0 */
    {0x00,0x00,0x00,0xF8,0x00,0x00,0x00,0x00,0x00,0x00,0x00,0x33,0x30,0x00,0x00,0x00}, /* ! 1 */
    {0x00,0x10,0x0C,0x06,0x10,0x0C,0x06,0x00,0x00,0x00,0x00,0x00,0x00,0x00,0x00,0x00}, /* " 2 */
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    {0x00,0x06,0x01,0x01,0x02,0x02,0x04,0x04,0x00,0x00,0x00,0x00,0x00,0x00,0x00,0x00}, /* ~ 94 */
};

/* ========================= 软件 I2C 时序 ========================= */

/* 每次延时约 1us；一个 SCL 周期 3 次延时 ≈ 3us，SCL ≈ 330kHz
 *   72MHz → SystemCoreClock / 6000000 = 12 次空循环
 *    8MHz → 1，夹到下限 4（与原 8MHz 工程一致）
 * 若换更快的优化等级后显示不稳，把除数改小（循环次数变多 => 更慢）即可。
 */
static uint32_t s_oled_i2c_loops = 4;

static void OLED_I2C_DelayCfg(void)
{
    uint32_t n = SystemCoreClock / 6000000u;

    if (n < 4u)
    {
        n = 4u;
    }
    if (n > 32u)
    {
        n = 32u;
    }
    s_oled_i2c_loops = n;
}

#define OLED_I2C_DELAY()                                                        \
    do {                                                                        \
        volatile uint32_t oled_d;                                               \
        for (oled_d = 0; oled_d < s_oled_i2c_loops; oled_d++)                   \
        {                                                                       \
            __NOP();                                                            \
        }                                                                       \
    } while (0)

/* 写 1 释放总线（靠模块上的上拉电阻拉高），写 0 拉低 */
#define OLED_SCL_H()    HAL_GPIO_WritePin(OLED_SCL_GPIO_PORT, OLED_SCL_GPIO_PIN, GPIO_PIN_SET)
#define OLED_SCL_L()    HAL_GPIO_WritePin(OLED_SCL_GPIO_PORT, OLED_SCL_GPIO_PIN, GPIO_PIN_RESET)
#define OLED_SDA_H()    HAL_GPIO_WritePin(OLED_SDA_GPIO_PORT, OLED_SDA_GPIO_PIN, GPIO_PIN_SET)
#define OLED_SDA_L()    HAL_GPIO_WritePin(OLED_SDA_GPIO_PORT, OLED_SDA_GPIO_PIN, GPIO_PIN_RESET)

/* 开漏输出下 IDR 依然实时反映引脚电平，读应答不用切输入模式 */
#define OLED_SDA_READ() HAL_GPIO_ReadPin(OLED_SDA_GPIO_PORT, OLED_SDA_GPIO_PIN)

/* 控制字节：Co=0；D/C#=0 后面跟命令，D/C#=1 后面跟显存数据 */
#define OLED_CTRL_CMD           0x00
#define OLED_CTRL_DATA          0x40

/* ========================= 软件 I2C 底层 ========================= */

static void OLED_I2C_Start(void)
{
    OLED_SDA_H();
    OLED_SCL_H();
    OLED_I2C_DELAY();

    OLED_SDA_L();                       /* SCL 为高时 SDA 由高变低：起始条件 */
    OLED_I2C_DELAY();
    OLED_SCL_L();
    OLED_I2C_DELAY();
}

static void OLED_I2C_Stop(void)
{
    OLED_SDA_L();
    OLED_SCL_H();
    OLED_I2C_DELAY();

    OLED_SDA_H();                       /* SCL 为高时 SDA 由低变高：停止条件 */
    OLED_I2C_DELAY();
}

/* 发送一个字节，返回 1 表示收到从机应答，0 表示无应答 */
static uint8_t OLED_I2C_SendByte(uint8_t Byte)
{
    uint8_t i;
    uint8_t Ack;

    for (i = 0; i < 8; i++)
    {
        if ((Byte & 0x80) != 0)
        {
            OLED_SDA_H();
        }
        else
        {
            OLED_SDA_L();
        }
        Byte <<= 1;

        OLED_I2C_DELAY();
        OLED_SCL_H();                   /* 先建立数据，再给时钟上升沿 */
        OLED_I2C_DELAY();
        OLED_SCL_L();
        OLED_I2C_DELAY();
    }

    OLED_SDA_H();                       /* 主机释放 SDA，等从机在应答位拉低 */
    OLED_I2C_DELAY();
    OLED_SCL_H();
    OLED_I2C_DELAY();

    Ack = (OLED_SDA_READ() == GPIO_PIN_RESET) ? 1 : 0;

    OLED_SCL_L();
    OLED_I2C_DELAY();

    return Ack;
}

/* 一帧 = 起始 + 地址 + 控制字节 + 1 字节数据 + 停止 */
static uint8_t OLED_I2C_Write(uint8_t Ctrl, uint8_t Data)
{
    uint8_t Ack;

    OLED_I2C_Start();
    Ack  = OLED_I2C_SendByte(OLED_I2C_ADDRESS);
    Ack &= OLED_I2C_SendByte(Ctrl);
    Ack &= OLED_I2C_SendByte(Data);
    OLED_I2C_Stop();

    return Ack;
}

static uint8_t OLED_WriteCmd(uint8_t Cmd)
{
    return OLED_I2C_Write(OLED_CTRL_CMD, Cmd);
}

/* 批量写显存：控制字节只发一次，后面连续挂 Len 个数据字节
 * 全屏 1024 字节从 1024 帧压到 8 帧（每页一帧） */
static void OLED_WriteDataBlock(const uint8_t *Buf, uint16_t Len)
{
    uint16_t i;

    OLED_I2C_Start();
    (void)OLED_I2C_SendByte(OLED_I2C_ADDRESS);
    (void)OLED_I2C_SendByte(OLED_CTRL_DATA);

    for (i = 0; i < Len; i++)
    {
        (void)OLED_I2C_SendByte(Buf[i]);
    }

    OLED_I2C_Stop();
}

/* 页寻址模式下定位光标：先选页(0~7)，再设列地址(0~127)的低 4 位和高 4 位 */
static void OLED_SetPos(uint8_t Page, uint8_t Column)
{
    (void)OLED_WriteCmd(0xB0 | (Page & 0x07));
    (void)OLED_WriteCmd(0x00 | (Column & 0x0F));
    (void)OLED_WriteCmd(0x10 | ((Column >> 4) & 0x0F));
}

/* ========================= SSD1306 初始化 ========================= */

uint8_t OLED_Init(void)
{
    GPIO_InitTypeDef GPIO_InitStruct = {0};
    uint8_t Ack;

    OLED_I2C_DelayCfg();                /* 先按当前主频换算时基 */

    /* PB8/PB9 都在 GPIOB 上；若改到别的端口，这里要一并使能对应时钟 */
    __HAL_RCC_GPIOB_CLK_ENABLE();

    /* 覆盖 CubeMX 生成的推挽配置 —— I2C 必须开漏 */
    GPIO_InitStruct.Mode  = GPIO_MODE_OUTPUT_OD;
    GPIO_InitStruct.Pull  = GPIO_NOPULL;
    GPIO_InitStruct.Speed = GPIO_SPEED_FREQ_HIGH;

    GPIO_InitStruct.Pin = OLED_SCL_GPIO_PIN;
    HAL_GPIO_Init(OLED_SCL_GPIO_PORT, &GPIO_InitStruct);

    GPIO_InitStruct.Pin = OLED_SDA_GPIO_PIN;
    HAL_GPIO_Init(OLED_SDA_GPIO_PORT, &GPIO_InitStruct);

    OLED_SDA_H();
    OLED_SCL_H();
    HAL_Delay(20);                      /* 等 OLED 上电复位完成 */

    /* 先探测一次从机应答：接线错误时后面所有命令都是白发 */
    OLED_I2C_Start();
    Ack = OLED_I2C_SendByte(OLED_I2C_ADDRESS);
    OLED_I2C_Stop();
    if (Ack == 0)
    {
        return 0;
    }

    /* SSD1306 标准初始化序列（128x64） */
    (void)OLED_WriteCmd(0xAE);          /* 关显示 */
    (void)OLED_WriteCmd(0xD5);          /* 时钟分频比 / 振荡器频率 */
    (void)OLED_WriteCmd(0x80);
    (void)OLED_WriteCmd(0xA8);          /* 多路复用率 */
    (void)OLED_WriteCmd(0x3F);          /* 1/64 Duty */
    (void)OLED_WriteCmd(0xD3);          /* 显示偏移 */
    (void)OLED_WriteCmd(0x00);
    (void)OLED_WriteCmd(0x40);          /* 显示起始行 */
    (void)OLED_WriteCmd(0x8D);          /* 电荷泵 */
    (void)OLED_WriteCmd(0x14);          /* 打开电荷泵，不开屏幕不亮 */
    (void)OLED_WriteCmd(0x20);          /* 寻址模式 */
    (void)OLED_WriteCmd(0x02);          /* 页寻址模式 */
    (void)OLED_WriteCmd(0xA1);          /* 左右方向正常 */
    (void)OLED_WriteCmd(0xC8);          /* 上下方向正常 */
    (void)OLED_WriteCmd(0xDA);          /* COM 引脚配置 */
    (void)OLED_WriteCmd(0x12);
    (void)OLED_WriteCmd(0x81);          /* 对比度 */
    (void)OLED_WriteCmd(0xCF);
    (void)OLED_WriteCmd(0xD9);          /* 预充电周期 */
    (void)OLED_WriteCmd(0xF1);
    (void)OLED_WriteCmd(0xDB);          /* VCOMH 电压 */
    (void)OLED_WriteCmd(0x40);
    (void)OLED_WriteCmd(0xA4);          /* 显示内容跟随显存 */
    (void)OLED_WriteCmd(0xA6);          /* 正常显示（不反色） */

    OLED_Clear();                       /* 先清屏再开显示，避免上电花屏 */

    (void)OLED_WriteCmd(0xAF);          /* 开显示 */

    return 1;
}

void OLED_Clear(void)
{
    static const uint8_t Zero[OLED_WIDTH] = {0};
    uint8_t Page;

    for (Page = 0; Page < (OLED_HEIGHT / 8); Page++)
    {
        OLED_SetPos(Page, 0);
        OLED_WriteDataBlock(Zero, OLED_WIDTH);
    }
}

/* ========================= 字符 / 数值显示 ========================= */

void OLED_ShowChar(uint8_t Line, uint8_t Col, char Ch)
{
    const uint8_t *Font;
    uint8_t Page;
    uint8_t Column;
    uint8_t i;
    uint8_t Buf[8];

    if (Line < 1u || Line > (OLED_HEIGHT / 16u))
    {
        return;
    }
    if (Col < 1u || Col > (OLED_WIDTH - 7u))
    {
        return;
    }

    /* 字库只覆盖 ASCII 可打印字符 ' ' ~ '~'，其它字符按空格显示 */
    if (Ch < ' ' || Ch > '~')
    {
        Ch = ' ';
    }

    Page   = (uint8_t)((Line - 1u) * 2u);   /* 一个 8x16 字符跨 2 页 */
    Column = (uint8_t)(Col - 1u);
    Font   = &OLED_F8x16[(uint8_t)(Ch - ' ')][0];

    for (i = 0; i < 8u; i++)                /* 上半部分 */
    {
        Buf[i] = Font[i];
    }
    OLED_SetPos(Page, Column);
    OLED_WriteDataBlock(Buf, 8u);

    for (i = 0; i < 8u; i++)                /* 下半部分 */
    {
        Buf[i] = Font[i + 8u];
    }
    OLED_SetPos((uint8_t)(Page + 1u), Column);
    OLED_WriteDataBlock(Buf, 8u);
}

void OLED_ShowString(uint8_t Line, uint8_t Col, const char *Str)
{
    while (*Str != '\0')
    {
        if (Col > (OLED_WIDTH - 7u))        /* 右边界之外不再显示 */
        {
            break;
        }
        OLED_ShowChar(Line, Col, *Str);
        Col = (uint8_t)(Col + 8u);
        Str++;
    }
}

void OLED_ShowNum(uint8_t Line, uint8_t Col, uint32_t Num, uint8_t Len)
{
    char Buf[11];
    uint8_t i;

    if (Len > 10u)
    {
        Len = 10u;
    }

    for (i = 0; i < Len; i++)
    {
        Buf[Len - 1u - i] = (char)('0' + (Num % 10u));
        Num /= 10u;
    }
    Buf[Len] = '\0';

    OLED_ShowString(Line, Col, Buf);
}

void OLED_ShowSignedNum(uint8_t Line, uint8_t Col, int32_t Num, uint8_t Len)
{
    uint32_t AbsNum;

    if (Num < 0)
    {
        OLED_ShowChar(Line, Col, '-');
        AbsNum = (uint32_t)(-(int64_t)Num);
    }
    else
    {
        OLED_ShowChar(Line, Col, '+');
        AbsNum = (uint32_t)Num;
    }

    OLED_ShowNum(Line, (uint8_t)(Col + 8u), AbsNum, Len);
}

void OLED_ShowHexNum(uint8_t Line, uint8_t Col, uint32_t Num, uint8_t Len)
{
    static const char HexTab[] = "0123456789ABCDEF";
    char Buf[11];
    uint8_t i;

    if (Len > 8u)
    {
        Len = 8u;
    }

    for (i = 0; i < Len; i++)
    {
        Buf[Len - 1u - i] = HexTab[Num & 0x0Fu];
        Num >>= 4;
    }
    Buf[Len] = '\0';

    OLED_ShowString(Line, Col, Buf);
}

/* 浮点显示：不调用 printf，避免勾选 -u_printf_float 带来的几十 KB 开销。
 * 例：OLED_ShowFloat(1, 41, 6.35f, 2, 1)  -> "6.3"
 *     OLED_ShowFloat(1, 41, -0.42f, 1, 2) -> "-0.42"
 */
void OLED_ShowFloat(uint8_t Line, uint8_t Col, float Val, uint8_t IntLen, uint8_t DecLen)
{
    char Buf[20];
    char Tmp[12];
    uint8_t n = 0;
    uint8_t t = 0;
    uint8_t i;
    uint8_t Neg = 0;
    uint32_t Scale = 1;
    uint32_t Abs;
    uint32_t Int;
    uint32_t Dec;

    if (DecLen > 6u)
    {
        DecLen = 6u;
    }
    if (IntLen > 10u)
    {
        IntLen = 10u;
    }
    for (i = 0; i < DecLen; i++)
    {
        Scale *= 10u;
    }

    if (Val < 0.0f)
    {
        Neg = 1;
        Val = -Val;
    }

    /* 四舍五入到定点整数，之后全部用整数运算 */
    Abs = (uint32_t)(int32_t)((Val * (float)Scale) + 0.5f);

    if (Neg != 0u)
    {
        Buf[n++] = '-';
    }

    /* 整数部分 */
    Int = Abs / Scale;
    do
    {
        Tmp[t++] = (char)('0' + (Int % 10u));
        Int /= 10u;
    } while ((Int != 0u) && (t < 12u));

    while ((t < IntLen) && (t < 12u))       /* 不足 IntLen 位补 0 */
    {
        Tmp[t++] = '0';
    }
    while (t > 0u)
    {
        Buf[n++] = Tmp[--t];
    }

    /* 小数部分 */
    if (DecLen != 0u)
    {
        Dec = Abs % Scale;

        Buf[n++] = '.';
        for (i = 0; i < DecLen; i++)
        {
            Buf[n + DecLen - 1u - i] = (char)('0' + (Dec % 10u));
            Dec /= 10u;
        }
        n = (uint8_t)(n + DecLen);
    }

    Buf[n] = '\0';
    OLED_ShowString(Line, Col, Buf);
}
